#include "fiffel.dtsi"

&kscan0 {
  /* Cols: D0,D1,D2,D3,D4,D5 -> 2,3,5,6,7,8 */
  col-gpios = <&pro_micro 4 GPIO_ACTIVE_HIGH>,
              <&pro_micro 5 GPIO_ACTIVE_HIGH>,
              <&pro_micro 6 GPIO_ACTIVE_HIGH>,
              <&pro_micro 7 GPIO_ACTIVE_HIGH>,
              <&pro_micro 8 GPIO_ACTIVE_HIGH>,
              <&pro_micro 9 GPIO_ACTIVE_HIGH>;
};
