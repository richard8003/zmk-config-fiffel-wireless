## boards_backup2/shields/fiffel/Kconfig.defconfig
```kconfig
if SHIELD_FIFFEL_LEFT

config ZMK_KEYBOARD_NAME
    default "Fiffel"

config ZMK_SPLIT_ROLE_CENTRAL
    default y


#config ZMK_USB
#    default y     # USB endast på central

endif

if SHIELD_FIFFEL_RIGHT || SHIELD_FIFFEL_LEFT

config ZMK_SPLIT
    default y

endif
```

## boards_backup2/shields/fiffel/Kconfig.shield
```kconfig
config SHIELD_FIFFEL_LEFT
    def_bool $(shields_list_contains,fiffel_left)

config SHIELD_FIFFEL_RIGHT
    def_bool $(shields_list_contains,fiffel_right)
```
